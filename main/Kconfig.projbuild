## main/Kconfig.projbuild
```kconfig
menu "Example Configurations"
    config EXAMPLE_ENABLE_SD_CARD
        bool "Enable SD Card"
        default n
        help 
            Enabling this option will initialize the SD card, so the SD card needs to be inserted into the slot. Additionally, if using the Video Player example, an MJPEG format video must be saved on the SD card.

    menu "HomeCare MQTT"
        config HOMECARE_MQTT_BROKER_URI
            string "MQTT broker URI"
            default ""
            help
                MQTT broker used by the HomeCare hub. Leave empty to disable MQTT until
                deployment-specific credentials are configured locally. Supported schemes
                follow ESP-MQTT, such as mqtt://, mqtts://, ws://, and wss://.

        config HOMECARE_MQTT_CLIENT_ID
            string "MQTT client ID"
            default "homecare-hub"
            help
                Client ID sent when connecting to the broker.

        config HOMECARE_MQTT_USERNAME
            string "MQTT username"
            default ""
            help
                Username sent when connecting to the broker.

        config HOMECARE_MQTT_PASSWORD
            string "MQTT password"
            default ""
            help
                Password sent when connecting to the broker. Keep credentials in a local
                sdkconfig or NVS provisioning flow instead of checked-in defaults.

        config HOMECARE_MQTT_INBOUND_CMD_TOPIC
            string "Inbound smart-car command topic"
            default "smartcar/cmd"
            help
                Additional MQTT topic for smart-car style downlink commands such as {"data":{"nav":"pause"}} or plain text stop.

        config HOMECARE_MQTT_INBOUND_SMARTCAR_DATA_TOPIC
            string "Inbound smart-car data topic"
            default "smartcar/attitude"
            help
                  Smart-car telemetry topic published by the ESP32-S3 patrol car. The current parser understands payloads like {"r":1.25,"p":-2.50,"y":178.80,"mag":true,"ts":123456789}.

        config HOMECARE_MQTT_INBOUND_SYSTEM_STATUS_TOPIC
            string "Inbound smart-car system status topic"
            default "smartcar/system/status"
            help
                Retained SmartCar state-machine status used to drive the terminal scene mode.

        config HOMECARE_MQTT_INBOUND_AUX_TOPIC
            string "Inbound auxiliary device topic"
            default ""
            help
                Optional second external device topic. Leave empty to disable. This can be used later for uvc_st7735_display(1) after its actual MQTT publish topic is confirmed.

        config HOMECARE_MQTT_INBOUND_CSI_SUMMARY_TOPIC
            string "Inbound CSI summary topic"
            default "devices/+/csi/summary"
            help
                CSI acquisition terminal summary topic. The payload is CSI_SUMMARY JSON
                with amp[] values for lightweight P4-side waveform display.

        config HOMECARE_MQTT_INBOUND_RADAR_RESULT_TOPIC
            string "Inbound radar result topic"
            default "devices/+/radar/result"
            help
                CSI acquisition terminal radar result topic used for presence/motion events.

        config HOMECARE_MQTT_BASE_TOPIC
            string "Base topic"
            default "homecare/hub"
            help
                Base topic for receive and forward channels. The app subscribes to BASE/in/# and BASE/cmd/#, and publishes to BASE/out/#.

        config HOMECARE_MQTT_QUEUE_SIZE
            int "Inbound queue size"
            range 1 32
            default 8
            help
                Number of decoded MQTT messages buffered for the UI.
    endmenu

    menu "HomeCare Weather"
        config HOMECARE_WEATHER_ENABLE
            bool "Enable real weather fetching"
            default y
            help
                Fetch live outdoor weather over HTTPS instead of relying on demo-only hardcoded text.

        config HOMECARE_WEATHER_LATITUDE
            string "Weather latitude"
            default "30.2741"
            help
                Latitude used for live weather requests. Set it to the deployment location of the device.

        config HOMECARE_WEATHER_LONGITUDE
            string "Weather longitude"
            default "120.1551"
            help
                Longitude used for live weather requests. Set it to the deployment location of the device.

        config HOMECARE_WEATHER_REFRESH_MINUTES
            int "Weather refresh interval (minutes)"
            range 5 240
            default 15
            help
                Background refresh interval for real weather data.
    endmenu

    menu "CameraMode MQTT Viewer"
        config CAMERA_MQTT_ENABLE
            bool "Enable CameraMode MQTT JPEG receiver"
            default y
            help
                Subscribes to the CameraMode JPEG topic and displays the received
                binary JPEG frames in the Camera app. Leave the broker URI empty to
                keep the receiver disabled at runtime.

        config CAMERA_MQTT_BROKER_URI
            string "MQTT broker URI"
            depends on CAMERA_MQTT_ENABLE
            default ""
            help
                Broker used by CameraMode. Use the same mqtt:// or mqtts:// URI as
                the CameraMode sender.

        config CAMERA_MQTT_CLIENT_ID
            string "MQTT client ID"
            depends on CAMERA_MQTT_ENABLE
            default "brookesia-camera-viewer"

        config CAMERA_MQTT_USERNAME
            string "MQTT username"
            depends on CAMERA_MQTT_ENABLE
            default ""

        config CAMERA_MQTT_PASSWORD
            string "MQTT password"
            depends on CAMERA_MQTT_ENABLE
            default ""

        config CAMERA_MQTT_JPEG_TOPIC
            string "JPEG binary topic"
            depends on CAMERA_MQTT_ENABLE
            default "cam/jpeg"
            help
                CameraMode publishes binary JPEG frames to this topic.

        config CAMERA_MQTT_CONTROL_TOPIC
            string "Control topic"
            depends on CAMERA_MQTT_ENABLE
            default ""
            help
                Leave empty to use JPEG topic + /control. The Camera app publishes
                {"cmd":"mode","value":"mqtt"} or {"cmd":"mode","value":"lcd"} here.

        config CAMERA_MQTT_STATUS_TOPIC
            string "Status topic"
            depends on CAMERA_MQTT_ENABLE
            default ""
            help
                Leave empty to use JPEG topic + /status. CameraMode publishes
                retained JSON such as {"mode":"mqtt"} here.

        config CAMERA_MQTT_MAX_JPEG_BYTES
            int "Maximum JPEG payload bytes"
            depends on CAMERA_MQTT_ENABLE
            range 4096 1048576
            default 262144

        config CAMERA_MQTT_BUFFER_SIZE
            int "MQTT receive buffer size"
            depends on CAMERA_MQTT_ENABLE
            range 4096 262144
            default 8192
            help
                ESP-MQTT may still split a large frame into multiple callbacks; the
                receiver reassembles fragments up to Maximum JPEG payload bytes.
                Keep this small: it is allocated as one contiguous block from
                internal RAM, so a large value can exhaust the heap and fail init.

        config CAMERA_MQTT_DECODE_TASK_STACK
            int "JPEG decode task stack"
            depends on CAMERA_MQTT_ENABLE
            range 4096 24576
            default 8192

        config CAMERA_MQTT_DECODE_TASK_PRIORITY
            int "JPEG decode task priority"
            depends on CAMERA_MQTT_ENABLE
            range 1 15
            default 5
    endmenu
endmenu
```
